/*
	PCD8544 LCD a.k.a Nokia 5110 LCD driver library. 
	Includes low-power CPU options and memory/cycle saving options 
	
	Last modified 13 Feb 2022
	Written by ADBeta
	
	Add dumb functions to just write data to the screen
	
	Add font array that can be disabled to save space
	

*/

#include "Arduino.h"
#include "PCD8544.h"

/*****************    Hardware Control    *****************/
void PCD8544::writeBit(byte bit) {
	//Safety check on the given bit
	bit &= 0x01;
	
	//Write bit to the bus
	digitalWrite(p_DAT, bit);
	
	//Cycle clock pin to latch bit
	digitalWrite(p_CLK, HIGH);
	digitalWrite(p_CLK, LOW);
}

void PCD8544::writeByte(byte data) {
	digitalWrite(p_CE, LOW); //Start transmission
	
	//Send bits MSB First
	for(int8_t cbit = 7; cbit >= 0; cbit--) {
		uint8_t dbit = (data >> cbit) & 0x01;
		
		writeBit(dbit);
	}
	digitalWrite(p_CE, HIGH); //End transmission	
}

/*****************    Screen Control    *****************/
void PCD8544::sendCMD(byte data) {
	digitalWrite(p_DC, LOW);
	writeByte(data);
}

void PCD8544::sendDAT(byte data) {
	digitalWrite(p_DC, HIGH);
	writeByte(data);
	
	//Incriment position value only if MEMARRAY is not defined (raw write mode)
	#ifdef DIRECT_ADDR
		incPos();
	#endif
}

void PCD8544::setPos(byte x, byte y) {
	//Limit values to correct range
	if(x > 83) x = 83;
	if(y > 5) y = 5;
	
	sendCMD(0x80 + x);
	sendCMD(0x40 + y);
	
	screenX = x;
	screenY = y;
}

void PCD8544::incPos() {
	++screenX;
	
	//Skip to next line if x is past 83	
	if(screenX == 84) {
		screenX = 0;
		
		++screenY;
		//If Y pos is greater than 6, reset its position
		if(screenY == 6) {
			screenY = 0;
		}
	}
}

void PCD8544::clear() {
	setPos(0, 0);
	
	//go through each column of the LCD and blank it   84 * 6 = 504
	for(uint16_t col = 0; col < 504; col++) {
		sendDAT(0x00);
	}
	
	//Reset position after clear -- done automatically --
	//setPos(0, 0);
}

//TODO Add compile flag to this
void PCD8544::printChar(char input) {
	//Make sure input char is within usable range
	if(input < 0x20 || input > 0x7E) return;
	
	//align input char with the index of the array
	input = input - 0x20;
	
	//Output all 5 bytes of the font char at position [input]
	for(byte charByte = 0; charByte < 5; charByte++) {
		sendDAT(pgm_read_byte(&(font[input][charByte])));
	}
}

void PCD8544::printString(const char *input) {
	byte crrChar = 0;
	while(input[crrChar] != '\0') {
		printChar(input[crrChar]);
		sendDAT(0x00); //Add a space
		
		++crrChar;
	}
}

void PCD8544::printIcon(const byte *icon, const byte length, const byte height) {
	//Keep track of the XPosition we started at to print icon corrctly
	byte startXPos = screenX;
	
	for(byte col = 0; col < height; col++) {
		
		//Get offset position of array, length + current collumn position
		unsigned int arrayOffset = length * col;
		
		for(byte row = 0; row < length; row++) {
			
			sendDAT(pgm_read_byte(&(icon[row + arrayOffset])));
		}
		
		//Set the position to the original X position, down 1 Y position
		setPos(startXPos, ++screenY);	
	}
}

/*****************    Configuration    *****************/
void PCD8544::init(byte RST, byte CLK, byte DAT, byte DC, byte CE) {
	//Set global pins
	p_RST = RST;
	p_CLK = CLK;
	p_DAT = DAT;
	p_DC = DC;
	p_CE = CE;
	
	//Pin states
	pinMode(p_RST, OUTPUT);
	pinMode(p_CLK, OUTPUT);
	pinMode(p_DAT, OUTPUT);
	pinMode(p_DC, OUTPUT);
	pinMode(p_CE, OUTPUT);
	
	//Set pin states
	digitalWrite(p_CE, HIGH);
	digitalWrite(p_CLK, LOW);
	digitalWrite(p_DAT, LOW);
	//Reset
	digitalWrite(p_RST, LOW);
	delay(1);
	digitalWrite(p_RST, HIGH);
	
	//LCD Init commands
	sendCMD(0x21); //Open Extended Commands
	sendCMD(contrast); //Set LCD VOP (Contrast)
	sendCMD(tempCoeff); //Set temp coefficient
	sendCMD(bias); //Set LCD Bias
	sendCMD(0x20); //Close Extended Commands, Basic Commands
	sendCMD(0x0C); //Normal mode
	
}

void PCD8544::invert(bool inv) {
	if(inv == 1) {
		sendCMD(0x0D);
	} 
	
	if(inv == 0) {
		sendCMD(0x0C);
	}
}

/*****************    Data Structures    *****************/
#ifdef FONT_EN
const PROGMEM byte font[100][5] = {
{0x00, 0x00, 0x00, 0x00, 0x00}, // 20
{0x00, 0x00, 0x5f, 0x00, 0x00}, // 21 ! 
{0x00, 0x07, 0x00, 0x07, 0x00}, // 22 ?
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{0x00, 0x41, 0x36, 0x08, 0x00} // 7d }
};
#else 
const PROGMEM byte font[0][0];
#endif

